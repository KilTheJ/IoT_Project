## zephyrproject/build/Kconfig/arch/Kconfig
```kconfig
# Load arch Kconfig descriptions.
osource "/home/seatech/zephyrproject/zephyr/arch/x86/Kconfig"
osource "/home/seatech/zephyrproject/zephyr/arch/xtensa/Kconfig"
osource "/home/seatech/zephyrproject/zephyr/arch/sparc/Kconfig"
osource "/home/seatech/zephyrproject/zephyr/arch/riscv/Kconfig"
osource "/home/seatech/zephyrproject/zephyr/arch/posix/Kconfig"
osource "/home/seatech/zephyrproject/zephyr/arch/nios2/Kconfig"
osource "/home/seatech/zephyrproject/zephyr/arch/mips/Kconfig"
osource "/home/seatech/zephyrproject/zephyr/arch/arm64/Kconfig"
osource "/home/seatech/zephyrproject/zephyr/arch/arm/Kconfig"
osource "/home/seatech/zephyrproject/zephyr/arch/arc/Kconfig"
```
